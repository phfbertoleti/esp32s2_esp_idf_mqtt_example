## proj_wifi_mqtt/main/Kconfig
```kconfig
# Kconfig com todas configurações particulares do projeto
menu "Configuracao - wifi (station)"

    choice ESP_WIFI_SCAN_AUTH_MODE_THRESHOLD
        prompt "Minima seguranca wifi permitida"
        default ESP_WIFI_AUTH_WPA_WPA2_PSK
        help
            Configuracao do minimo de seguranca permitida para conexao wifi (modo station).  

        config ESP_WIFI_AUTH_OPEN
            bool "OPEN"
        config ESP_WIFI_AUTH_WEP
            bool "WEP"
        config ESP_WIFI_AUTH_WPA_PSK
            bool "WPA PSK"
        config ESP_WIFI_AUTH_WPA2_PSK
            bool "WPA2 PSK"
        config ESP_WIFI_AUTH_WPA_WPA2_PSK
            bool "WPA/WPA2 PSK"
        config ESP_WIFI_AUTH_WPA3_PSK
            bool "WPA3 PSK"
        config ESP_WIFI_AUTH_WPA2_WPA3_PSK
            bool "WPA2/WPA3 PSK"
        config ESP_WIFI_AUTH_WAPI_PSK
            bool "WAPI PSK"
    endchoice

endmenu
```
